// thermal_math.h — the shared rate-limit / first-order-lag math for the oven plant (design.md
// §5, §6, §12, §15; backlog B2).
//
// The oven is a first-order thermal plant, so nearly every feature that predicts *time* or
// *feasibility* reduces to the same handful of formulas over a set of calibrated constants:
//   - how long an ASAP ramp takes         -> rampDurationSeconds() = ∫ dT / rate(T)   (§15 ETA)
//   - whether a requested ramp is possible -> rateLimitRamp()                          (§12
//   preview)
//   - what the board temperature will do   -> lpStep() + boardTempEstimate()           (§6 {a,b,τ})
//   - UV exposure -> hold seconds          -> exposureToHoldSeconds()                  (§5/§6)
//   - feedforward holding duty             -> steadyStateDuty()                        (§5/§6 A5)
//
// The *constants* live in oven_cal.h (generated by the offline calibration fit — §6/§7); this
// header is only the math over them, and every function takes the model (or a sub-struct) by
// argument rather than reaching into oven_cal::DEFAULT, so it is unit-testable with toy constants
// and the eventual generated-file swap is a data-only change. B2 ships primitives, not policy: the
// fan-Auto decision (B3), the PID loop (A5) and the recipe validation/labeling (B1) each own their
// policy and consume these.
//
// Pure C++: no LVGL, no Arduino, no <cmath> (avoid transcendentals) — host-tested under
// native_logic_cyd and compiled into both firmwares unchanged.
#pragma once

#include <cstdint>

// Units throughout: temperature °C, time seconds, rate °C/s, duty 0..1, beamCoverage a 0..1
// fraction, RPM rev/min. float everywhere (the ESP32 has hardware float; duty is a float, §11).

// clamp helper (no <algorithm> — keep the include surface minimal).
inline float clampf(float v, float lo, float hi) {
  if (v < lo)
    return lo;
  if (v > hi)
    return hi;
  return v;
}

// A max heat/cool-rate envelope, modelled affine in temperature: rate(T) = slope·T + intercept,
// held within [floor, ceiling] (§6 "max heat/cool-rate envelopes ... temperature-dependent —
// heating faster when cold, cooling passive/one-sided"). slope = 0 gives a constant rate, i.e. the
// idealized-linear curve an uncalibrated oven shows (§12). The `floor` also guarantees the
// rampDurationSeconds integrand never divides by ~0.
struct RateEnvelope {
  float slope;     // °C/s per °C
  float intercept; // °C/s at T = 0
  float floor;     // °C/s, minimum achievable rate (> 0)
  float ceiling;   // °C/s, maximum achievable rate

  float rate(float T) const { return clampf(slope * T + intercept, floor, ceiling); }
};

// First-order board-temp lag model (§6, planning-only lumped-RC):
//   T_board_est = a · LP_τ(T_wall) + b
// where LP_τ is a first-order low-pass of the wall temperature with time constant τ (seconds).
struct LagParams {
  float a;   // affine gain (dimensionless)
  float b;   // offset (°C)
  float tau; // low-pass time constant (seconds, > 0)
};

// Feedforward inverse-plant model (§6, an A5 feedforward deliverable): the steady-state holding
// duty duty_ss(T) = slope·T + intercept (affine, clamped 0..1 by steadyStateDuty), plus the
// effective duty→heat-rate gain (°C/s per unit duty) A5 uses to convert a desired ramp rate into a
// feedforward duty bump.
struct DutyModel {
  float slope;     // duty per °C
  float intercept; // duty at T = 0
  float rateGain;  // °C/s per unit duty (0..1)
};

// Every calibrated quantity is fan-conditioned — the convection/cooling fan changes the plant, so
// a single fit over mixed-fan data would average two different plants (§6). Each quantity therefore
// carries an `off` and an `on` variant, selected by the segment's resolved fan state.
template <typename T> struct FanPair {
  T off;
  T on;

  const T &pick(bool fanOn) const { return fanOn ? on : off; }
};

// The whole plant model — the shape oven_cal.h fills with defaults and the calibration fit will
// regenerate. `calibrated` is false for the hand-authored stub so consumers can label previews
// "uncalibrated / estimated" (§12, §6).
struct OvenModel {
  FanPair<RateEnvelope> heat; // conv_fan off/on
  FanPair<RateEnvelope> cool; // cool_fan off/on
  FanPair<LagParams> lag;     // conv_fan off/on
  FanPair<DutyModel> duty;    // conv_fan off/on
  float beamCoverage;         // 0..1 fraction of a rotation a surface is in the UV beam (§6)
  float turntableRpm;         // rev/min (§6; dose is RPM-independent, this only sets evenness)
  bool calibrated;            // false = defaults only → idealized preview (§12)
};

// --- Rate envelopes (fan-conditioned lookups) --------------------------------------------------

inline float heatRate(const OvenModel &m, float T, bool convFan) {
  return m.heat.pick(convFan).rate(T);
}

inline float coolRate(const OvenModel &m, float T, bool coolFan) {
  return m.cool.pick(coolFan).rate(T);
}

// --- Ramp duration: the ETA / ASAP-ramp integral (§15) -----------------------------------------

// Numeric ∫ dT / rate(T) between two temperatures (§15: "an ASAP ramp time = ∫ dT / heatRate(T)
// across the ramp (numeric — rate is temp-dependent)"). Direction-agnostic — pass the heat envelope
// for a rising ramp, the cool envelope for a falling one. Midpoint rule over a fixed subdivision
// count so the cost is bounded regardless of span. Returns seconds (0 for a zero-width ramp).
inline float rampDurationSeconds(const RateEnvelope &env, float tFrom, float tTo) {
  const float span = tTo - tFrom;
  const float absSpan = span < 0 ? -span : span;
  if (absSpan <= 0.0f)
    return 0.0f;

  constexpr int kSubdivisions = 64; // bounded cost; ample for a smooth affine envelope
  const float dT = absSpan / kSubdivisions;
  const float dir = span < 0 ? -1.0f : 1.0f;
  float seconds = 0.0f;
  for (int i = 0; i < kSubdivisions; ++i) {
    const float midT = tFrom + dir * dT * (i + 0.5f);
    seconds += dT / env.rate(midT); // env.rate() is floored > 0, so never divides by ~0
  }
  return seconds;
}

// --- Feasibility / rate limiting (§12) ---------------------------------------------------------

// The result of clamping a requested ramp to what the plant can physically do.
struct RampFeasibility {
  float achievableSeconds; // the fastest the plant can make this ramp
  bool rateLimited;        // true if the request was faster than achievable (→ amber warn, §12/B1)
};

// A requested ramp over `requestedSeconds` (0 = "as fast as possible", §5). If the request is
// faster than the calibrated envelope allows, it is clamped to the achievable time and flagged;
// otherwise the request is honored. Feeds B1's "physically-optimistic" amber validation and C5's
// solid achievable curve (§12).
inline RampFeasibility rateLimitRamp(const RateEnvelope &env, float tFrom, float tTo,
                                     float requestedSeconds) {
  const float achievable = rampDurationSeconds(env, tFrom, tTo);
  if (requestedSeconds <= 0.0f || requestedSeconds < achievable) {
    return RampFeasibility{achievable, requestedSeconds > 0.0f};
  }
  return RampFeasibility{requestedSeconds, false};
}

// --- First-order board-temp lag (§6 / §15 projected curve) -------------------------------------

// One first-order low-pass step: advances `prev` toward `input` over `dtSeconds` with time
// constant `tau`. Uses the exact-for-a-step-input discrete form alpha = dt/(tau+dt) (no
// transcendentals). Feeds the projected/dotted trajectory the CYD draws (§15) and extends to the
// closed-loop overshoot preview (§12).
inline float lpStep(float prev, float input, float dtSeconds, float tau) {
  if (tau <= 0.0f)
    return input; // degenerate: no lag
  const float alpha = dtSeconds / (tau + dtSeconds);
  return prev + alpha * (input - prev);
}

// The affine readout of the lag model: T_board_est = a · lpWall + b (§6).
inline float boardTempEstimate(const LagParams &lag, float lpWall) {
  return lag.a * lpWall + lag.b;
}

// --- Cure exposure ↔ hold seconds (§5 / §6) ----------------------------------------------------

// A cure hold is authored as UV exposure per surface; the hold seconds are y = exposure /
// beamCoverage (§5/§6). Guards a non-positive beamCoverage (returns 0 rather than dividing by
// zero) — B1 does the "estimated" labeling off model.calibrated / a conservative-low beamCoverage.
inline float exposureToHoldSeconds(float exposurePerSurface, float beamCoverage) {
  if (beamCoverage <= 0.0f)
    return 0.0f;
  return exposurePerSurface / beamCoverage;
}

// Inverse: the per-surface exposure a hold of `holdSeconds` delivers, ≈ y · beamCoverage
// (RPM-independent, §6).
inline float perSurfaceExposure(float holdSeconds, float beamCoverage) {
  return holdSeconds * beamCoverage;
}

// --- Feedforward (§5 / §6, consumed by A5) -----------------------------------------------------

// Steady-state holding duty duty_ss(T) for the resolved fan state, clamped to 0..1 (§6). A5's PID
// adds feedback on top of this feedforward term.
inline float steadyStateDuty(const OvenModel &m, float T, bool convFan) {
  const DutyModel &d = m.duty.pick(convFan);
  return clampf(d.slope * T + d.intercept, 0.0f, 1.0f);
}
